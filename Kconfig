## Kconfig
```kconfig
# SPDX-License-Identifier: MIT
#
# Custom input processor: taps a direction-specific behavior once per
# accumulated tick of a continuous relative axis (e.g. trackball Y motion
# -> C_VOLUME_UP/C_VOLUME_DOWN taps), since ZMK's own behaviors input
# processor is documented as button-only and can't tell direction apart.

config ZMK_INPUT_PROCESSOR_AXIS_BEHAVIORS
    bool "Axis Behaviors input processor"
    default y
    depends on ZMK_POINTING
    depends on DT_HAS_ZMK_INPUT_PROCESSOR_AXIS_BEHAVIORS_ENABLED
```

## boards/shields/corne/Kconfig.defconfig
```kconfig
if SHIELD_CORNE_DONGLE

# Max 16 characters in keyboard name
config ZMK_KEYBOARD_NAME
    default "Chocofi"

config ZMK_SPLIT_ROLE_CENTRAL
    default y

config ZMK_SPLIT
    default y

# The number of peripherals this dongle serves:
# corne_left, corne_right, trackball = 3.
config ZMK_SPLIT_BLE_CENTRAL_PERIPHERALS
    default 3

# Set this to ZMK_SPLIT_BLE_CENTRAL_PERIPHERALS + your desired number of BT profiles (default is 5)
config BT_MAX_CONN
    default 8

# Set this to the same number as BT_MAX_CONN
config BT_MAX_PAIRED
    default 8

endif
```

## boards/shields/corne/Kconfig.shield
```kconfig
config SHIELD_MY_KEYBOARD_DONGLE
    def_bool $(shields_list_contains,corne_dongle)
```

## boards/shields/corne_trackball/Kconfig.defconfig
```kconfig
if SHIELD_CORNE_TRACKBALL

config ZMK_KEYBOARD_NAME
    default "Trackball"

config ZMK_SPLIT
    default y

config ZMK_SPLIT_ROLE_CENTRAL
    default n

config ZMK_POINTING
    default y

# PMW3610 driver (badjeff/zmk-pmw3610-driver). It talks to the sensor over
# hardware SPI (the single SDIO line is wired to both MOSI and MISO), so
# SPI + pinctrl are required even though there's no dedicated SPI header used.
config PINCTRL
    default y

config SPI
    default y

config PMW3610_ALT
    default y

endif
```

## boards/shields/corne_trackball/Kconfig.shield
```kconfig
config SHIELD_CORNE_TRACKBALL
    def_bool $(shields_list_contains,corne_trackball)
```

## boards/shields/trackball/Kconfig.defconfig
```kconfig
if SHIELD_TRACKBALL

config ZMK_KEYBOARD_NAME
    default "Trackball"

config ZMK_SPLIT
    default y

config ZMK_SPLIT_ROLE_CENTRAL
    default n

# The split link to the dongle is BLE - this shield is useless without it.
# ZMK_BLE has no default of its own at zmk v0.3; it normally comes from
# ZMK's per-board conf (app/boards/seeeduino_xiao_ble.conf), but state it
# here too so a board-name change can't silently build a radio-less
# trackball again.
config ZMK_BLE
    default y

config ZMK_POINTING
    default y

# PMW3610 driver (badjeff/zmk-pmw3610-driver). It talks to the sensor over
# hardware SPI (the single SDIO line is wired to both MOSI and MISO), so
# SPI + pinctrl are required even though there's no dedicated SPI header used.
config PINCTRL
    default y

config SPI
    default y

config PMW3610_ALT
    default y

endif
```

## config/west.yml
```yaml
manifest:
  remotes:
    - name: zmkfirmware
      url-base: https://github.com/zmkfirmware
    - name: badjeff
      url-base: https://github.com/badjeff
    - name: nuovotaka
      url-base: https://github.com/nuovotaka
  projects:
    - name: zmk
      remote: zmkfirmware
      revision: v0.3
      import: app/west.yml
    - name: zmk-pmw3610-driver
      remote: badjeff
      # PMW3610 trackball sensor driver. Pinned commit (2026-04-16).
      revision: 44b4a76b74d293a93cec4ccb7e04cb8d29c10f93
    - name: zmk-pointing-acceleration-alpha
      remote: nuovotaka
      # Pointer acceleration. Community "alpha" module, not an official ZMK
      # feature. Pinned commit (2026-07-14).
      revision: 780dfcd6b796063367893ff41e233773e12fb07c
  self:
    path: config
```

## dts/bindings/input_processors/zmk,input-processor-axis-behaviors.yaml
```yaml
# SPDX-License-Identifier: MIT

description: |
  Input processor that watches a single relative axis code and taps a
  direction-specific behavior once per `tick` of accumulated movement,
  e.g. converting trackball Y motion into repeated C_VOLUME_UP/DOWN taps.
  Unlike zmk,input-processor-behaviors (button events only, no direction),
  this accumulates signed movement and dispatches to one of two bindings
  depending on which direction crossed the threshold.

compatible: "zmk,input-processor-axis-behaviors"

include: ip_zero_param.yaml

properties:
  type:
    type: int
    description: Input event type to watch. Defaults to INPUT_EV_REL.
  code:
    type: int
    required: true
    description: The single input code to watch, e.g. INPUT_REL_Y.
  tick:
    type: int
    required: true
    description: Accumulated magnitude of movement required to trigger one tap.
  tap-interval-ms:
    type: int
    default: 40
    description: |
      Minimum time between taps, which caps the tap rate no matter how fast
      the axis moves (40 = at most 25 taps/sec). Taps run deferred on the
      system workqueue; never invoke behaviors from the input path directly.
  bindings:
    type: phandle-array
    required: true
    description: Exactly two bindings - [0] taps on negative accumulation, [1] taps on positive accumulation.
```
